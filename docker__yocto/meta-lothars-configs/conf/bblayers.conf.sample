## docker__yocto/meta-lothars-configs/conf/bblayers.conf.sample
```bitbake
## LAYER_CONF_VERSION is increased each time build/conf/bblayers.conf
## changes incompatibly
##
##
## removed from setup:
##  ~/poky/openembedded-core
##  ~/poky/meta-openembedded/meta-ruby 
LCONF_VERSION = "6"

BBPATH = "${TOPDIR}"
BBFILES ?= ""

BBLAYERS ?= " \
  ~/poky/meta \
  ~/poky/meta-yocto \
  ~/poky/meta-yocto-bsp \
  ~/poky/meta-ti \
  ~/poky/meta-qt5 \
  ~/poky/meta-openembedded/meta-oe \
  "
BBLAYERS_NON_REMOVABLE ?= " \
  ~/poky/meta \
  ~/poky/meta-yocto \
  "
```

## docker__yocto/meta-lothars-configs/conf/layer.conf
```bitbake
# append conf and classes directory to BBPATH
BBPATH .= ":${LAYERDIR}"

# add recipes directory to BBFILES
BBFILES += "${LAYERDIR}/recipes*/*/*.bb ${LAYERDIR}/recipes*/*/*.bbappend"

BBFILE_COLLECTIONS += "meta-lothars-configs"
BBFILE_PATTERN_meta-lothars-configs := "^${LAYERDIR}/"
# in case increase the number
BBFILE_PRIORITY_meta-lothars-configs = "10"
LAYERSERIES_COMPAT_meta-lothars-configs = "warrior zeus"
# opt
BBDEBUG = "yes"
```
